/*
 * Copyright (c) 2020 The ZMK Contributors
 *
 * SPDX-License-Identifier: MIT
 */

/* Sweep (cradio shield) keymap shim.
 *
 * Defines the 4 thumb bindings per layer, then pulls in the shared keymap.
 * See common.dtsi for all layers, behaviors, and combos.

                 KEY POSITIONS

  ╭────────────────────╮ ╭────────────────────╮
  │  0   1   2   3   4 │ │  5   6   7   8   9 │
  │ 10  11  12  13  14 │ │ 15  16  17  18  19 │
  │ 20  21  22  23  24 │ │ 25  26  27  28  29 │
  ╰───────────╮ 30  31 │ │ 32  33 ╭───────────╯
              ╰────────╯ ╰────────╯            */

#define T_BASE  &lt NAV TAB &kp SPC    &kp RET &lt SYM BSPC
#define T_NAV   &none   &none      &none   &none
#define T_SYM   &none   &none      &none   &none

/* No third thumb key on this board: pressing both left thumbs = ESC,
   both right thumbs = DEL (combos defined in common.dtsi). */
#define SWEEP_THUMB_COMBOS

#include "common.dtsi"
